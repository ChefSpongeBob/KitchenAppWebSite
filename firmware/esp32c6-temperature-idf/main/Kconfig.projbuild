## firmware/esp32c6-temperature-idf/main/Kconfig.projbuild
```kconfig
menu "Crimini Temperature Firmware"

choice CRIMINI_FIRMWARE_ROLE
  prompt "Firmware role"
  default CRIMINI_FIRMWARE_ROLE_GATEWAY

  config CRIMINI_FIRMWARE_ROLE_GATEWAY
    bool "Temperature gateway"

  config CRIMINI_FIRMWARE_ROLE_SENSOR_NODE
    bool "Battery sensor node"
endchoice

endmenu
```

## firmware/esp32c6-temperature-idf/sdkconfig.defaults
```kconfig
CONFIG_IDF_TARGET_ESP32C6=y
CONFIG_LOG_DEFAULT_LEVEL_INFO=y
CONFIG_ESP_SYSTEM_PANIC_PRINT_REBOOT=y
CONFIG_FREERTOS_HZ=1000
CONFIG_IEEE802154_ENABLED=y
```
